## template/Kconfig
```kconfig
#
# For a description of the syntax of this configuration file,
# see Documentation/kbuild/kconfig-language.txt.
#
mainmenu "Kmake/$(ARCH) $(KERNELVERSION) Kernel Configuration"

source "kmake/Kconfig.include"
source "arch/$(SRCARCH)/Kconfig"
```
